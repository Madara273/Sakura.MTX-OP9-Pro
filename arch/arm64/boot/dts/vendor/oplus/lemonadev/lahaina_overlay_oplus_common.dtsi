/*this is for different project dtsi*/
&qupv3_se0_i2c {

    status = "okay";

    mp2650-charger@5c {
        status = "okay";
        compatible = "oplus,mp2650-charger";
        reg = <0x5c 0>;

        qcom,mps_otg_en-gpio = <&pm8350c_gpios 1 0x00>;
        pinctrl-names = "mps_otg_en_active", "mps_otg_en_sleep", "mps_otg_en_default";
        pinctrl-0 = <&mps_otg_en_active>;
        pinctrl-1 = <&mps_otg_en_sleep>;
        pinctrl-2 = <&mps_otg_en_default>;
    };
};
&reserved_memory {
	/*
	 * Lahaina has empty memory available at 0xb0000000 to 0xd0000000.
	 * 0xb0000000 is used by WLAN/CNSS, so we shift ramoops to avoid conflict.
	 */
	ramoops: ramoops@b1000000 {
		compatible   = "ramoops";
		reg          = <0x00 0xb1000000 0x00 0x100000>;
		no-map;
		ecc-size     = <16>;
		record-size  = <0x40000>;
		console-size = <0x40000>;
		pmsg-size    = <0x40000>;
		max-reason   = <4>;
		status       = "okay";
    };
};
